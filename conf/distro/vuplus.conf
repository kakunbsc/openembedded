## conf/distro/vuplus.conf
```bitbake
#@--------------------------------------------------------------------
#@TYPE: Distribution
#@NAME: vuplus <http://db-project.com>
#@--------------------------------------------------------------------

SYSVINIT_ENABLED_GETTYS = ""

INHERIT += "packaged-staging"
INHERIT += "package_ipk debian"

DISTRO = "vuplus"
DISTRO_NAME = "DB-PROJECT"
DISTRO_VERSION = "1.6.2"


TARGET_OS = "linux"
#TARGET_VENDOR = "-oe" is set at sane-toolchanin.inc
TARGET_VENDOR = "-vuplus"

#OLDEST_KERNEL = "2.6.16"

#
## Basic configuration
#
IMAGE_DEV_MANAGER = "udev"
DISTRO_SSH_DAEMON = "dropbear"
IMAGE_INIT_MANAGER = "sysvinit"
IMAGE_INITSCRIPTS ?= "initscripts-vuplus"
IMAGE_LOGIN_MANAGER ?= ""
IMAGE_FSTYPES ?= "tar.bz2 jffs2"


#Images built can have to modes:
# 'debug': empty rootpassword, strace included
# 'release' no root password, no strace and gdb by default
#DISTRO_TYPE ?= "debug"
#DISTRO_TYPE = "release"


#2.8
#FEED_URIS += "official##http://archive.vuplus.com/openembedded/1.1/vuplus/${MACHINE}/feeds/stable"
DISTRO_FEED_URI = "http://archive.vuplus.com/openembedded/${DISTRO_VERSION}/vuplus/${MACHINE}/feeds/stable"

# If we're using an .ipk based rootfs, we want to have opkg-nogpg installed so postinst script can run
IPKG_VARIANT = "opkg-nogpg"


# for sane-toolchain.inc:
LIBC ?= "eglibc"
#LIBC ?= "glibc"
PREFERRED_BINUTILS ?= "2.20"
PREFERRED_GCC_VERSION ?= "4.4.3"
#PREFERRED_BINUTILS ?= "2.18.50.0.7"
#PREFERRED_GCC_VERSION ?= "4.1.1"



PREFERRED_VERSION_automake ?= "1.10.2"
PREFERRED_VERSION_automake-native ?= "1.10.2"
#PREFERRED_VERSION_busybox ?= "1.13.2"
PREFERRED_VERSION_busybox ?= "1.15.3"
PREFERRED_VERSION_libsigc++-1.2 ?= "1.2.5"
#PREFERRED_VERSION_linux-libc-headers ?= "2.6.23"
#PREFERRED_VERSION_linux-libc-headers ?= "2.6.12.0"
PREFERRED_VERSION_linux-libc-headers ?= "2.6.18"
PREFERRED_VERSION_swig-native ?= "1.3.39"
PREFERRED_VERSION_wpa-supplicant ?= "0.6.7"
#PREFERRED_VERSION_samba = "3.3.13"
PREFERRED_VERSION_samba = "3.0.37"
PREFERRED_VERSION_ushare = "1.1a"
#PREFERRED_VERSION_liboil = "0.3.14"
PREFERRED_VERSION_hdparm = "6.6"

PREFERRED_PROVIDER_avahi = "avahi"
PREFERRED_PROVIDER_opkg = "opkg-nogpg"
PREFERRED_PROVIDER_initscripts = "initscripts-vuplus"
PREFERRED_PROVIDER_virtual/db = "db"
PREFERRED_PROVIDER_virtual/db-native = "db-native"
PREFERRED_PROVIDER_bluez-libs = "bluez-libs"
PREFERRED_PROVIDER_libfribidi = "libfribidi"

PREFERRED_PROVIDER_virtual/javac-native = "ecj-bootstrap-native"
PREFERRED_PROVIDER_virtual/java-native = "jamvm-native"
PREFERRED_PROVIDER_virtual/java-initial = "jamvm-initial"

PREFERRED_PROVIDER_classpath-native = "classpath-minimal"
PREFERRED_PROVIDER_classpath = "classpath-minimal"

PREFERRED_VERSION_jamvm-initial = "1.4.5"
PREFERRED_VERSION_classpath-initial = "0.93"

PREFERRED_VERSION_libecj-bootstrap = "3.4"

PREFERRED_VERSION_jamvm-native = "1.5.3"
PREFERRED_VERSION_classpath-native = "0.98"

PREFERRED_VERSION_jamvm = "1.5.3"
PREFERRED_VERSION_classpath = "0.98"

SRCREV_pn-opkg = "455"

require conf/distro/include/sane-srcdates.inc
require conf/distro/include/sane-srcrevs.inc
require conf/distro/include/sane-toolchain.inc
require conf/distro/include/sane-feed-ipk.inc


#
PREFERRED_VERSION_autoconf-native = "2.61"


#oe complaint
PREFERRED_PROVIDER_virtual/libqte2 = "qte"


# glibc:
#PREFERRED_PROVIDER_virtual/libiconv ?= "glibc"
#PREFERRED_PROVIDER_virtual/libintl ?= "glibc"
#PREFERRED_PROVIDER_virtual/libc ?= "glibc"
#PREFERRED_PROVIDER_virtual/${TARGET_PREFIX}libc-initial ?= "glibc-initial"
#PREFERRED_PROVIDER_linux-libc-headers ?= "linux-libc-headers"

# Virtuals:
#PREFERRED_PROVIDER_virtual/${TARGET_PREFIX}binutils = "binutils-cross"
#PREFERRED_PROVIDER_virtual/${TARGET_PREFIX}gcc-initial = "gcc-cross-initial"
#PREFERRED_PROVIDER_virtual/${TARGET_PREFIX}gcc-intermediate = "gcc-cross-intermediate"
#PREFERRED_PROVIDER_virtual/${TARGET_PREFIX}gcc = "gcc-cross"
#PREFERRED_PROVIDER_virtual/${TARGET_PREFIX}g++ = "gcc-cross"

# hostap stuff, we prefer the in-kernel modules, but those don't work for all machines
#PREFERRED_PROVIDER_hostap-conf                      ?= "hostap-conf"
#PREFERRED_PROVIDER_hostap-modules_h2200             ?= "hostap-modules"
#PREFERRED_PROVIDER_hostap-modules_hx4700            ?= "hostap-modules"

#PREFERRED_PROVIDER_virtual/db           ?= "db"
#PREFERRED_PROVIDER_virtual/db-native    ?= "db-native"
#PREFERRED_PROVIDER_virtual/libsdl       ?= "libsdl-x11"
#PREFERRED_PROVIDER_virtual/libx11       ?= "libx11"
#PREFERRED_PROVIDER_virtual/xserver      ?= "xserver-kdrive"

# Others:
#PREFERRED_PROVIDER_linux-libc-headers = "linux-libc-headers"
#PREFERRED_PROVIDER_dbus-glib             = "dbus-glib"
#PREFERRED_PROVIDER_esound               ?= "pulseaudio"
#PREFERRED_PROVIDER_gconf                ?= "gconf-dbus"
#PREFERRED_PROVIDER_gnome-vfs            ?= "gnome-vfs"
#PREFERRED_PROVIDER_gnome-vfs-plugin-file ?= "gnome-vfs"
#PREFERRED_PROVIDER_tslib                ?= "tslib"
#PREFERRED_PROVIDER_tslib-conf           ?= "tslib"
#PREFERRED_PROVIDER_libgpewidget         ?= "libgpewidget"
#PREFERRED_PROVIDER_ntp                  ?= "ntp"
#PREFERRED_PROVIDER_hotplug               = "udev"
#PREFERRED_PROVIDER_libxss                = "libxss"
#PREFERRED_PROVIDER_bluez-utils-dbus      = "bluez-utils"
#PREFERRED_PROVIDER_bluez-libs            = "bluez4"

# we don't ship gtk-directfb by default
#PREFERRED_PROVIDER_gtk+                   ?= "gtk+"
#PREFERRED_PROVIDER_gdk-pixbuf-loader-ani  ?= "gtk+"
#PREFERRED_PROVIDER_gdk-pixbuf-loader-bmpg ?= "gtk+"
#PREFERRED_PROVIDER_gdk-pixbuf-loader-gif  ?= "gtk+"
#PREFERRED_PROVIDER_gdk-pixbuf-loader-ico  ?= "gtk+"
#PREFERRED_PROVIDER_gdk-pixbuf-loader-jpeg ?= "gtk+"
#PREFERRED_PROVIDER_gdk-pixbuf-loader-pcx  ?= "gtk+"
#PREFERRED_PROVIDER_gdk-pixbuf-loader-png  ?= "gtk+"
#PREFERRED_PROVIDER_gdk-pixbuf-loader-pnm  ?= "gtk+"
#PREFERRED_PROVIDER_gdk-pixbuf-loader-ras  ?= "gtk+"
#PREFERRED_PROVIDER_gdk-pixbuf-loader-tga  ?= "gtk+"
#PREFERRED_PROVIDER_gdk-pixbuf-loader-wbmp ?= "gtk+"
#PREFERRED_PROVIDER_gdk-pixbuf-loader-xbm  ?= "gtk+"
#PREFERRED_PROVIDER_gdk-pixbuf-loader-xpm  ?= "gtk+"
```

## conf/machine/vusolo.conf
```bitbake
#@TYPE: Machine
#@NAME: vusolo
#@DESCRIPTION: Machine configuration for the VuPlus

TARGET_ARCH = "mipsel"

PREFERRED_VERSION_linux-bm750 = "2.6.18"
PREFERRED_VERSION_linux-libc-headers = "2.6.18"


PREFERRED_PROVIDER_virtual/kernel = "linux-${MACHINE}"

MACHINE_ESSENTIAL_EXTRA_RDEPENDS = "kernel vuplus-dvb-modules \
        kernel-module-isofs \
        kernel-module-sr-mod    kernel-module-usb-storage \
        kernel-module-cdrom \
        kernel-module-msdos kernel-module-vfat kernel-module-fat \
        kernel-module-ntfs \
        kernel-module-nls-base kernel-module-nls-iso8859-1 kernel-module-nls-cp437 \
        kernel-module-nls-iso8859-15 kernel-module-nls-cp850 \
        kernel-module-nls-utf8 \
        kernel-module-i2c-core kernel-module-firmware-class kernel-module-input kernel-module-evdev \
        kernel-module-snd-pcm kernel-module-snd \
        "   

MACHINE_ESSENTIAL_EXTRA_RRECOMMENDS = "\
        kernel-module-cifs \
        kernel-module-exportfs \
        kernel-module-ext2 \
        kernel-module-reiserfs \
        kernel-module-xfs \
	"
TARGET_FPU = "hard"

# used by sysvinit_2
#SERIAL_CONSOLE = "115200 ttyS0"


MACHINE_FEATURES += "kernel26"

TARGET_CC_ARCH = "-march=mips32"


DISTRO_FEATURES += " mplt"




PREFERRED_PROVIDER_task-vuplus-dvbapi = "task-vuplus-dvbapi3"
PREFERRED_PROVIDER_task-vuplus-ui = "task-vuplus-enigma2"





#GLIBC_ADDONS = "nptl" which will be set at glibc_xxx.bb. Setting here causes a configure error.
GLIBC_ADDONS ?= "ports,nptl,libidn"
GLIBC_EXTRA_OECONF = "--disable-profile --with-tls --without-fp --with-__thread"

PREFERRED_PROVIDER_xserver = "xserver-kdrive"

EXTRA_IMAGEDEPENDS += "vuplus-makenfi-native"

MACHINE_FEATURES += "alsa pci"


EXTRA_IMAGECMD_jffs2 = " --eraseblock=0x20000 -n -l "
IMAGE_CMD_jffs2 = " \
	cp ${IMAGE_ROOTFS}/boot/vmlinux.gz ${DEPLOY_DIR_IMAGE}/${IMAGE_NAME}.vmlinux.gz; \
	rm -f ${IMAGE_ROOTFS}/boot/vmlinux.gz; \
	mkfs.jffs2 --root=${IMAGE_ROOTFS}/boot --faketime \
	--disable-compressor=lzo --compression-mode=size \
       --output=${DEPLOY_DIR_IMAGE}/${IMAGE_NAME}.boot.jffs2 \
       ${EXTRA_IMAGECMD}; rm -rf ${IMAGE_ROOTFS}/boot/*; \
       rm -rf ${IMAGE_ROOTFS}/tmp/*; \
       mkfs.jffs2 --root=${IMAGE_ROOTFS} \
	--disable-compressor=lzo --compression-mode=size \
       --output=${DEPLOY_DIR_IMAGE}/${IMAGE_NAME}.rootfs.jffs2 \
       ${EXTRA_IMAGECMD}; \
       vfi3 ${DEPLOY_DIR_IMAGE}/${IMAGE_NAME}.rootfs.jffs2 ${DEPLOY_DIR_IMAGE}/${IMAGE_NAME}.boot.jffs2 ${DEPLOY_DIR_IMAGE}/${IMAGE_NAME}.vmlinux.gz > ${DEPLOY_DIR_IMAGE}/${IMAGE_NAME}.nfi; \
        mkdir -p ${DEPLOY_DIR_IMAGE}/vuplus/solo; \
        cp ${DEPLOY_DIR_IMAGE}/${IMAGE_NAME}.rootfs.jffs2 ${DEPLOY_DIR_IMAGE}/vuplus/solo/root_cfe_auto.jffs2; \
        cp ${DEPLOY_DIR_IMAGE}/${IMAGE_NAME}.vmlinux.gz ${DEPLOY_DIR_IMAGE}/vuplus/solo/kernel_cfe_auto.bin; \
        cp ${DEPLOY_DIR_IMAGE}/${IMAGE_NAME}.boot.jffs2 ${DEPLOY_DIR_IMAGE}/vuplus/solo/boot_cfe_auto.jffs2; \
        cd ${DEPLOY_DIR_IMAGE}; \
        rm -f usb_upgrade.zip; \
        zip solo_usb_upgrade.zip vuplus/solo/*; \
        rm -rf vuplus; \ 
	"
```
